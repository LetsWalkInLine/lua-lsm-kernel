## security/lua/Kconfig
```kconfig
# SPDX-License-Identifier: GPL-2.0-or-later

config SECURITY_LUA_LSM
	bool "Lua based LSM Support"
	depends on SECURITY && HAS_LUA
	select LUA
	default n
	help
	  This selects the Lua based LSM.
	  If you are unsure how to answer this question, answer N.

config SECURITY_LUA_LSM_STATS
	bool "Lua-LSM Statistics"
	depends on SECURITY_LUA_LSM
	default n
	help
	  This selects the lua-lsm statistics.
	  If you are unsure how to answer this question, answer N.

config SECURITY_LUA_LSM_DEBUG
	bool "Lua-LSM kernel debugging support"
	depends on SECURITY_LUA_LSM
	default n
	help
	  This enables debugging code designed to help Lua-LSM kernel
	  developers, unless you know what this does in the kernel code you
	  should leave this disabled.

config SECURITY_LUA_LSM_KUNIT_TEST
	bool "KUnit tests for Lua-LSM errors and execution budgets"
	depends on SECURITY_LUA_LSM=y && KUNIT=y && AUDIT
	default n
	help
	  Test hook error propagation, return mapping, VM recovery and
	  allocation failures using the production Lua-LSM dispatchers.

config SECURITY_LUA_LSM_TEST_PROBE
	bool "Lua-LSM receive selftest observer"
	depends on SECURITY_LUA_LSM=y && KPROBES && SECURITY_NETWORK
	default n
	help
	  Log actual receive hook return values and softirq context with a
	  kretprobe. Enable only in a disposable selftest guest.
```
